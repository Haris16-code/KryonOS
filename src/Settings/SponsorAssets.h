#ifndef SPONSOR_ASSETS_H
#define SPONSOR_ASSETS_H

#include <Arduino.h>
#include <TFT_eSPI.h>
#include <cstring>

// Generated by tools/logo_to_rgb565.py from C:/Users/saifia/.gemini/antigravity/brain/0b3f023a-bb50-43cc-99b6-f818c48e3f93/.user_uploaded/media_1794252154835_8177199a.png
// Dimensions: 166x50 pixels (16600 bytes)
#define AMERIDROID_LOGO_RGB565_WIDTH  166
#define AMERIDROID_LOGO_RGB565_HEIGHT 50
static const uint16_t AMERIDROID_LOGO_RGB565[8300] PROGMEM = {
    0x10A2, 0x10A2, 0x10A2, 0x10A2, 0x10A2, 0x10A2, 0x10A2, 0x3901, 0x71A1, 0xAA40, 0xCAA0, 0xE2E0,
    0xFB00, 0xFB20, 0xFB20, 0xF300, 0xDAC0, 0xC280, 0xA220, 0x69A1, 0x3901, 0x10A2, 0x10A2, 0x10A2,
    0x10A2, 0x10A2, 0x10A2, 0x10A2, 0x10A2, 0x10A2, 0x10A2, 0x10A2, 0x10A2, 0x10A2, 0x10A2, 0x10A2,
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    0x10A2, 0x10A2, 0x10A2, 0x10A2, 0x10A2, 0x10A2, 0x10A2, 0x10A2
};

// ============================================================================
// EXTENSIBLE SPONSOR REGISTRY
// ============================================================================
// To add a new sponsor in the future:
// 1. Run: python tools/logo_to_rgb565.py path/to/logo.png NEW_SPONSOR_LOGO_RGB565 >> src/Settings/SponsorAssets.h
// 2. Append one entry to SPONSOR_LIST[] below.
// Pagination (< / > arrows and 1/N indicator) and runtime QR code generation
// will activate automatically!

struct SponsorEntry {
    const char* name;             // Shown in QR modal header (e.g. "ameriDroid")
    const char* tagline;          // Shown below logo (e.g. "Official Hardware Partner")
    const char* url;              // Shown below QR & encoded into QR code automatically
    const uint16_t* logoRgb565;   // Pointer to PROGMEM RGB565 array (or nullptr for text-only)
    uint16_t logoW;               // Logo width in pixels
    uint16_t logoH;               // Logo height in pixels
    uint16_t accentColor;         // Card border / highlight color (RGB565)
};

static const SponsorEntry SPONSOR_LIST[] = {
    {
        "ameriDroid",
        "Official Hardware Partner",
        "https://ameridroid.com/",
        AMERIDROID_LOGO_RGB565,
        AMERIDROID_LOGO_RGB565_WIDTH,
        AMERIDROID_LOGO_RGB565_HEIGHT,
        0xFD20 // ameriDroid Orange accent
    }
    // Add future sponsors here!
};

static constexpr size_t SPONSOR_COUNT = sizeof(SPONSOR_LIST) / sizeof(SPONSOR_LIST[0]);

static constexpr const char* KRYONOS_SUPPORT_DISPLAY_URL = "https://kryonos.harislab.tech/sponsor";
static constexpr const char* KRYONOS_SUPPORT_SHORT_URL   = "kryonos.harislab.tech/sponsor";
static constexpr const char* KRYONOS_SUPPORT_FULL_URL    = "https://kryonos.harislab.tech/sponsor";

// Helper to render PROGMEM RGB565 bitmap with proper byte-swap restoration
static inline void drawSponsorLogoProgmem(TFT_eSPI* tft, int16_t x, int16_t y, uint16_t w, uint16_t h, const uint16_t* progmemBmp) {
    if (!tft || !progmemBmp) return;
    bool oldSwap = tft->getSwapBytes();
    tft->setSwapBytes(true);
    tft->pushImage(x, y, w, h, progmemBmp);
    tft->setSwapBytes(oldSwap);
}

// ============================================================================
// ON-DEVICE RUNTIME QR CODE GENERATOR (ISO/IEC 18004 Versions 1..5, ECC Level L)
// ============================================================================
// Generates QR codes dynamically at runtime from any URL string up to 106 chars.
// Uses single-block Reed-Solomon GF(256) with zero heap allocations.
namespace MiniQR {

    struct VersionInfo {
        uint8_t version;
        uint8_t size;
        uint8_t totalCodewords;
        uint8_t ecCodewords;
        uint8_t dataCapacityBytes;
        uint8_t alignCenter; // 0 if no alignment pattern (V1), else center coord
    };

    static const VersionInfo VERSIONS[5] = {
        { 1, 21,  26,  7,  17,  0 },
        { 2, 25,  44, 10,  32, 18 },
        { 3, 29,  70, 15,  53, 22 },
        { 4, 33, 100, 20,  78, 26 },
        { 5, 37, 134, 26, 106, 30 }
    };

    static inline uint8_t gfMul(uint8_t x, uint8_t y) {
        uint8_t r = 0;
        for (int i = 7; i >= 0; --i) {
            r = (r << 1) ^ ((r & 0x80) ? 0x1D : 0x00);
            if ((y >> i) & 1) r ^= x;
        }
        return r;
    }

    static void rsComputeRemainder(const uint8_t* data, uint8_t dataLen, uint8_t degree, uint8_t* result) {
        uint8_t gen[32];
        memset(gen, 0, sizeof(gen));
        gen[degree - 1] = 1;
        uint8_t root = 1;
        for (uint8_t i = 0; i < degree; ++i) {
            for (uint8_t j = 0; j < degree; ++j) {
                gen[j] = gfMul(gen[j], root);
                if (j + 1 < degree) gen[j] ^= gen[j + 1];
            }
            root = gfMul(root, 0x02);
        }

        memset(result, 0, degree);
        for (uint8_t i = 0; i < dataLen; ++i) {
            uint8_t factor = data[i] ^ result[0];
            memmove(result, result + 1, degree - 1);
            result[degree - 1] = 0;
            for (uint8_t j = 0; j < degree; ++j) {
                result[j] ^= gfMul(gen[j], factor);
            }
        }
    }

    static inline void setFunctionModule(uint8_t modules[37][37], bool isFunc[37][37], int x, int y, bool dark, int size) {
        if (x >= 0 && x < size && y >= 0 && y < size) {
            modules[y][x] = dark ? 1 : 0;
            isFunc[y][x] = true;
        }
    }

    static void drawFinderPattern(uint8_t modules[37][37], bool isFunc[37][37], int cx, int cy, int size) {
        for (int dy = -4; dy <= 4; ++dy) {
            for (int dx = -4; dx <= 4; ++dx) {
                int dist = max(abs(dx), abs(dy));
                int xx = cx + dx, yy = cy + dy;
                if (xx >= 0 && xx < size && yy >= 0 && yy < size) {
                    bool dark = (dist != 2 && dist != 4);
                    setFunctionModule(modules, isFunc, xx, yy, dark, size);
                }
            }
        }
    }

    static void drawAlignmentPattern(uint8_t modules[37][37], bool isFunc[37][37], int cx, int cy, int size) {
        for (int dy = -2; dy <= 2; ++dy) {
            for (int dx = -2; dx <= 2; ++dx) {
                bool dark = (max(abs(dx), abs(dy)) != 1);
                setFunctionModule(modules, isFunc, cx + dx, cy + dy, dark, size);
            }
        }
    }

    static void drawFormatBits(uint8_t modules[37][37], bool isFunc[37][37], uint8_t mask, int size) {
        // ECC Level L = 01 (binary)
        uint32_t data = (1 << 3) | mask;
        uint32_t rem = data;
        for (int i = 0; i < 10; ++i) {
            rem = (rem << 1) ^ ((rem >> 9) * 0x537);
        }
        uint32_t bits = ((data << 10) | rem) ^ 0x5412;

        for (int i = 0; i <= 5; ++i) setFunctionModule(modules, isFunc, 8, i, ((bits >> i) & 1) != 0, size);
        setFunctionModule(modules, isFunc, 8, 7, ((bits >> 6) & 1) != 0, size);
        setFunctionModule(modules, isFunc, 8, 8, ((bits >> 7) & 1) != 0, size);
        setFunctionModule(modules, isFunc, 7, 8, ((bits >> 8) & 1) != 0, size);
        for (int i = 9; i < 15; ++i) setFunctionModule(modules, isFunc, 14 - i, 8, ((bits >> i) & 1) != 0, size);

        for (int i = 0; i < 8; ++i) setFunctionModule(modules, isFunc, size - 1 - i, 8, ((bits >> i) & 1) != 0, size);
        for (int i = 8; i < 15; ++i) setFunctionModule(modules, isFunc, 8, size - 15 + i, ((bits >> i) & 1) != 0, size);
        setFunctionModule(modules, isFunc, 8, size - 8, true, size);
    }

    // Encodes `text` into `modules[37][37]` and returns the grid dimension (21..37), or 0 on error
    static uint8_t encodeText(const char* text, uint8_t modules[37][37]) {
        if (!text) return 0;
        size_t len = strlen(text);
        const VersionInfo* vi = nullptr;
        for (int i = 0; i < 5; ++i) {
            if (len <= VERSIONS[i].dataCapacityBytes) {
                vi = &VERSIONS[i];
                break;
            }
        }
        if (!vi) return 0;

        uint8_t size = vi->size;
        uint8_t dataCap = vi->totalCodewords - vi->ecCodewords;

        // 1. Build bit stream: Mode 0100 (Byte), 8-bit char count, payload bytes, terminator, pad bytes
        uint8_t codewords[140];
        memset(codewords, 0, sizeof(codewords));
        int bitLen = 0;
        auto appendBits = [&](uint32_t val, int numBits) {
            for (int i = numBits - 1; i >= 0; --i, ++bitLen) {
                codewords[bitLen >> 3] |= ((val >> i) & 1) << (7 - (bitLen & 7));
            }
        };

        appendBits(0x4, 4); // Byte mode
        appendBits((uint32_t)len, 8);
        for (size_t i = 0; i < len; ++i) {
            appendBits((uint8_t)text[i], 8);
        }
        int capacityBits = dataCap * 8;
        appendBits(0, min(4, capacityBits - bitLen));
        appendBits(0, (8 - (bitLen % 8)) % 8);
        for (uint8_t padByte = 0xEC; bitLen < capacityBits; padByte ^= (0xEC ^ 0x11)) {
            appendBits(padByte, 8);
        }

        // 2. Compute Reed-Solomon ECC codewords (Single block for V1..V5 Level L)
        rsComputeRemainder(codewords, dataCap, vi->ecCodewords, codewords + dataCap);

        // 3. Initialize function patterns
        bool isFunc[37][37];
        memset(modules, 0, 37 * 37);
        memset(isFunc, 0, sizeof(isFunc));

        for (int i = 0; i < size; ++i) {
            setFunctionModule(modules, isFunc, 6, i, (i % 2 == 0), size);
            setFunctionModule(modules, isFunc, i, 6, (i % 2 == 0), size);
        }
        drawFinderPattern(modules, isFunc, 3, 3, size);
        drawFinderPattern(modules, isFunc, size - 4, 3, size);
        drawFinderPattern(modules, isFunc, 3, size - 4, size);

        if (vi->alignCenter > 0) {
            drawAlignmentPattern(modules, isFunc, vi->alignCenter, vi->alignCenter, size);
        }
        drawFormatBits(modules, isFunc, 0, size);

        // 4. Zig-zag codeword placement
        int iBit = 0;
        int totalBits = vi->totalCodewords * 8;
        for (int right = size - 1; right >= 1; right -= 2) {
            if (right == 6) right = 5;
            for (int vert = 0; vert < size; ++vert) {
                for (int j = 0; j < 2; ++j) {
                    int x = right - j;
                    bool upward = ((right + 1) & 2) == 0;
                    int y = upward ? (size - 1 - vert) : vert;
                    if (!isFunc[y][x] && iBit < totalBits) {
                        bool dark = ((codewords[iBit >> 3] >> (7 - (iBit & 7))) & 1) != 0;
                        modules[y][x] = dark ? 1 : 0;
                        ++iBit;
                    }
                }
            }
        }

        // 5. Apply Mask 0 ((x + y) % 2 == 0) and finalize format bits
        for (int y = 0; y < size; ++y) {
            for (int x = 0; x < size; ++x) {
                if (!isFunc[y][x] && ((x + y) % 2 == 0)) {
                    modules[y][x] ^= 1;
                }
            }
        }
        drawFormatBits(modules, isFunc, 0, size);
        return size;
    }

    // Renders a QR code centered at `centerX`, starting at `topY`, fitting within `maxBoxSize`
    static void drawDynamicQRCode(TFT_eSPI* tft, const char* url, int centerX, int topY, int maxBoxSize) {
        if (!tft || !url) return;
        uint8_t modules[37][37];
        uint8_t gridSize = encodeText(url, modules);
        if (gridSize == 0) return;

        int quietZone = 2; // 2-module white quiet zone around QR
        int totalModules = gridSize + quietZone * 2;
        int scale = maxBoxSize / totalModules;
        if (scale < 2) scale = 2;

        int boxSize = totalModules * scale;
        int boxX = centerX - (boxSize / 2);
        int boxY = topY;

        // Crisp white QR background plate with subtle border
        tft->fillRoundRect(boxX - 2, boxY - 2, boxSize + 4, boxSize + 4, 6, TFT_WHITE);
        tft->drawRoundRect(boxX - 2, boxY - 2, boxSize + 4, boxSize + 4, 6, TFT_SILVER);

        int qrStartX = boxX + quietZone * scale;
        int qrStartY = boxY + quietZone * scale;

        for (uint8_t r = 0; r < gridSize; ++r) {
            for (uint8_t c = 0; c < gridSize; ++c) {
                if (modules[r][c]) {
                    tft->fillRect(qrStartX + c * scale, qrStartY + r * scale, scale, scale, TFT_BLACK);
                }
            }
        }
    }

} // namespace MiniQR

#endif // SPONSOR_ASSETS_H

